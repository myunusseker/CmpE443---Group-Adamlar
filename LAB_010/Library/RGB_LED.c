#include "RGB_LED.h"

void RGB_LED_Init() {
	GPIO_DIR_Write(RED_LED_PORT,RED_LED_MASK,OUTPUT);
	GPIO_DIR_Write(GREEN_LED_PORT,GREEN_LED_MASK,OUTPUT);
	GPIO_DIR_Write(BLUE_LED_PORT,BLUE_LED_MASK,OUTPUT);
	
	GPIO_PIN_Write(RED_LED_PORT,RED_LED_MASK,HIGH);
	GPIO_PIN_Write(GREEN_LED_PORT,GREEN_LED_MASK,HIGH);
	GPIO_PIN_Write(BLUE_LED_PORT,BLUE_LED_MASK,HIGH);
}

void RGB_LED_setColor(RGB_LED_Colors color) {
	if(color == RED) {
		GPIO_PIN_Write(RED_LED_PORT,RED_LED_MASK,LOW);
		GPIO_PIN_Write(GREEN_LED_PORT,GREEN_LED_MASK,HIGH);
		GPIO_PIN_Write(BLUE_LED_PORT,BLUE_LED_MASK,HIGH);
	}
	else if(color == GREEN) {
		GPIO_PIN_Write(RED_LED_PORT,RED_LED_MASK,HIGH);
		GPIO_PIN_Write(GREEN_LED_PORT,GREEN_LED_MASK,LOW);
		GPIO_PIN_Write(BLUE_LED_PORT,BLUE_LED_MASK,HIGH);
	}
	else if(color == BLUE) {
		GPIO_PIN_Write(RED_LED_PORT,RED_LED_MASK,HIGH);
		GPIO_PIN_Write(GREEN_LED_PORT,GREEN_LED_MASK,HIGH);
		GPIO_PIN_Write(BLUE_LED_PORT,BLUE_LED_MASK,LOW);
	}
	else if(color == MAGENTA) {
		GPIO_PIN_Write(RED_LED_PORT,RED_LED_MASK,LOW);
		GPIO_PIN_Write(GREEN_LED_PORT,GREEN_LED_MASK,HIGH);
		GPIO_PIN_Write(BLUE_LED_PORT,BLUE_LED_MASK,LOW);
	}
	else if(color == CYAN) {
		GPIO_PIN_Write(RED_LED_PORT,RED_LED_MASK,HIGH);
		GPIO_PIN_Write(GREEN_LED_PORT,GREEN_LED_MASK,LOW);
		GPIO_PIN_Write(BLUE_LED_PORT,BLUE_LED_MASK,LOW);
	}
	else if(color == YELLOW) {
		GPIO_PIN_Write(RED_LED_PORT,RED_LED_MASK,LOW);
		GPIO_PIN_Write(GREEN_LED_PORT,GREEN_LED_MASK,LOW);
		GPIO_PIN_Write(BLUE_LED_PORT,BLUE_LED_MASK,HIGH);
	}
	else if(color == WHITE) {
		GPIO_PIN_Write(RED_LED_PORT,RED_LED_MASK,LOW);
		GPIO_PIN_Write(GREEN_LED_PORT,GREEN_LED_MASK,LOW);
		GPIO_PIN_Write(BLUE_LED_PORT,BLUE_LED_MASK,LOW);
	}
	else if(color == BLACK) {
		GPIO_PIN_Write(RED_LED_PORT,RED_LED_MASK,HIGH);
		GPIO_PIN_Write(GREEN_LED_PORT,GREEN_LED_MASK,HIGH);
		GPIO_PIN_Write(BLUE_LED_PORT,BLUE_LED_MASK,HIGH);
	}
}

